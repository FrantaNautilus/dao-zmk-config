/*
 * Copyright (c) 2021 Rafael Yumagulov
 *
 * SPDX-License-Identifier: MIT
 */

#include <behaviors.dtsi>
#include <dt-bindings/zmk/keys.h>
#include <dt-bindings/zmk/bt.h>

// Czech Linux keyboard
#include "keys_cs.h"

// Layer numbers
#define USDEF 0
#define USNUM 1
#define USNAV 2
#define USADJ 3
#define CSDEF 4
#define CSDIA 5
#define CSDII 6
#define CSNUM 7
#define CSNAV 8
#define CSADJ 9

// Other number definitions
#define TAPPING_TERM 150
#define SHIFT_TAP_MS 170
#define QUICK_TAP_MS 110
#define PRIOR_IDLE_MS 150
#define COMBO_TIME_MS 25

// Behavior customizations
// settings and homerow mods inspired by https://github.com/urob/zmk-config/

&sk {
  release-after-ms = <900>;
  quick-release;
};

&sl {
  ignore-modifiers;
};

&lt {
  flavor = "balanced";
  tapping-term-ms = <TAPPING_TERM>;
  quick-tap-ms = <QUICK_TAP_MS>;
};

&mt {
  quick_tap_ms = <QUICK_TAP_MS>;
};

// ZMK feature macros
// https://github.com/filterpaper/zmk-config

//additional  arguments for hold-trigger-key-positions and hold-trigger-on-release
// customizable hold-tap for keypress
#define HTK(name, tap_flavor, tap_term, ...)    \
  name: name##_hold_tap {                       \
    flavor          = #tap_flavor;              \
    compatible      = "zmk,behavior-hold-tap";  \
    tapping-term-ms = <tap_term>;               \
    quick-tap-ms    = <QUICK_TAP_MS>;           \
    require-prior-idle-ms = <PRIOR_IDLE_MS>;    \
    #binding-cells  = <2>;                      \
    bindings        = <&kp>, <&kp>;             \
    __VA_ARGS__                                 \
      };

// customizable hold-tap for sticky modifier
// first modifier
// second sticky modifier
#define HTKPSK(name, tap_flavor, tap_term, ...)    \
  name: name##_hold_tap {                       \
    flavor          = #tap_flavor;              \
    compatible      = "zmk,behavior-hold-tap";  \
    tapping-term-ms = <tap_term>;               \
    quick-tap-ms    = <QUICK_TAP_MS>;           \
    require-prior-idle-ms = <PRIOR_IDLE_MS>;    \
    #binding-cells  = <2>;                      \
    bindings        = <&kp>, <&sk>;             \
    __VA_ARGS__                                 \
      };


// customizeble hold-tap for any behavior
#define HTMOSL(name, tap_flavor, tap_term, ...) \
  name: name##_hold_tap {                       \
    flavor          = #tap_flavor;              \
    compatible      = "zmk,behavior-hold-tap";  \
    tapping-term-ms = <tap_term>;               \
    quick-tap-ms    = <QUICK_TAP_MS>;           \
    require-prior-idle-ms = <PRIOR_IDLE_MS>;    \
    #binding-cells = <2>;                       \
    bindings        = <&mo>, <&sl>;             \
    __VA_ARGS__                                 \
      };

// one-line combos
#define COMBO(name, pos, lrs, kp)               \
  combo_##name {                                \
    timeout-ms    = <25>;                       \
    bindings      = <kp>;                       \
    key-positions = <pos>;                      \
    layers        = <lrs>;                      \
  };

// one-line macros
#define MACRO(name, ...)                        \
  name: name##_macro {                          \
    compatible     = "zmk,behavior-macro";      \
    tap-ms         = <1>;                       \
    wait-ms        = <1>;                       \
    #binding-cells = <0>;                       \
    bindings       = __VA_ARGS__                \
  };

/ {
    chosen {
        zmk,physical_layout = &dao_crkbd_layout;
        // zmk,physical_layout = &dao_full_layout;
    };
};

/ {
  macros {                                                \
    // Czech symbols
    MACRO(cs_t_caron, <&macro_tap &kp CS_CARON &kp CS_T>;)\
    MACRO(cs_n_caron, <&macro_tap &kp CS_CARON &kp CS_N>;)\
    MACRO(cs_d_caron, <&macro_tap &kp CS_CARON &kp CS_D>;)\
    MACRO(cs_o_acute, <&macro_tap &kp CS_ACUTE &kp CS_O>;)\
    MACRO(us_th, <&macro_tap &kp T &kp H>;)\
    MACRO(us_ing, <&macro_tap &kp I &kp N &kp G>;)\
    MACRO(us_and, <&macro_tap &kp SPACE &kp A &kp N &kp D &kp SPACE>;)\
  };
  behaviors {                                             \
      HTK(lhrm, balanced, TAPPING_TERM)                   \
      HTK(rhrm, balanced, TAPPING_TERM)                   \
      HTMOSL(ldia_mosl, hold-preferred, TAPPING_TERM)     \
      HTMOSL(rdia_mosl, hold-preferred, TAPPING_TERM)     \
      HTKPSK(kpsk, balanced, TAPPING_TERM)                \
  };
  csquote: csquote {                                      \
      //label          = "csquote";
      compatible     = "zmk,behavior-mod-morph";          \
      #binding-cells = <0>;                               \
      bindings       = <&kp CS_SQT>, <&kp CS_DQT>;        \
      mods           = <(MOD_LSFT|MOD_RSFT)>;             \
  };
  csbslh: csbslh {                                        \
      //label          = "csbslh";
      compatible     = "zmk,behavior-mod-morph";          \
      #binding-cells = <0>;                               \
      bindings       = <&kp CS_BSLH>, <&kp CS_PIPE>;      \
      mods           = <(MOD_LSFT|MOD_RSFT)>;             \
  };
  csdot: csdot {                                          \
      //label          = "csdot";
      compatible     = "zmk,behavior-mod-morph";          \
      #binding-cells = <0>;                               \
      bindings       = <&kp CS_DOT>, <&kp CS_LT>;         \
      mods           = <(MOD_LSFT|MOD_RSFT)>;             \
  };
  cscomma: cscomma {                                      \
      //label          = "cscomma";
      compatible     = "zmk,behavior-mod-morph";          \
      #binding-cells = <0>;                               \
      bindings       = <&kp CS_COMMA>, <&kp CS_GT>;       \
      mods           = <(MOD_LSFT|MOD_RSFT)>;             \
  };
  csfslh: csfslh {                                        \
      //label          = "csfslh";
      compatible     = "zmk,behavior-mod-morph";          \
      #binding-cells = <0>;                               \
      bindings       = <&kp CS_FSLH>, <&kp CS_QMARK>;     \
      mods           = <(MOD_LSFT|MOD_RSFT)>;             \
  };
  cssemi: cssemi {                                        \
      //label          = "cssemi";
      compatible     = "zmk,behavior-mod-morph";          \
      #binding-cells = <0>;                               \
      bindings       = <&kp CS_SEMI>, <&kp CS_COLON>;     \
      mods           = <(MOD_LSFT|MOD_RSFT)>;             \
  };
  csgrave: csgrave {                                      \
      //label          = "cssemi";
      compatible     = "zmk,behavior-mod-morph";          \
      #binding-cells = <0>;                               \
      bindings       = <&kp CS_GRAVE>, <&kp CS_TILDE>;    \
      mods           = <(MOD_LSFT|MOD_RSFT)>;             \
  };
  csequal: csequal {                                      \
      //label          = "cssemi";
      compatible     = "zmk,behavior-mod-morph";          \
      #binding-cells = <0>;                               \
      bindings       = <&kp CS_EQUAL>, <&kp CS_PLUS>;     \
      mods           = <(MOD_LSFT|MOD_RSFT)>;             \
  };

  combos {
  // ------------------------------------------------------------------------------------------------------------
  // |  0    |  1  |  2  |  3   |  4   |  5   |          x         |  6   |  7    |  8    |  9   |  10   |  11   |
  // |  12   |  13 |  14 |  15  |  16  |  17  |          x         |  18  |  19   |  20   |  21  |  22   |  23   |
  // |  24   |  25 |  26 |  27  |  28  |  29  |          x         |  30  |  31   |  32   |  33  |  34   |  35   |
  //                            |  36  |  37  |  38    | x |  39   |  40  |  41   |
  //
  // ------------------------------------------------------------------------------------------------------------
  // |    R A L T  |  P L U S   |  E X C L    |          x         |  Q M A R K   |   S T A R    |    R A L T    |
  // |   TOG  LANG |   T A B    | U N D E R   |          x         |  C A R E T   |   E N T E R  |    L G U I    |
  // |   TOG   NAV |  M I N U S |    A T      |          x         |   H A S H    |   F S L H    |   TOG   NUM   |
  //                            |  36  |  37  |  38    | x |  39   |  40  |  41   |
  //
  // ------------------------------------------------------------------------------------------------------------
  // |  0    |  1  |  2  |   C O P Y   |  5   |          x         |  6   |   L B K T     |   R B K T    |  11   |
  // |  12   |  DOLLAR   |  P A S T E  |  17  |          x         |  18  |   L P A R     |   R P A R    |  23   |
  // |  24   |  PERCENT  |   A M P S   |  29  |          x         |  30  |   L B R C     |   R B R C    |  35   |
  //                            |  36  |  37  |  38    | x |  39   |  40  |  41   |
  //
    compatible = "zmk,combos";
    COMBO(lag, 0 1, USDEF USNUM CSDEF CSNUM, &kp RALT)
    COMBO(rag, 10 11, USDEF USNUM CSDEF CSNUM, &kp RALT)
    COMBO(csdeflayer, 12 13, USDEF, &to CSDEF)
    COMBO(usdeflayer, 12 13, CSDEF, &to USDEF)
    COMBO(usnavlayer, 24 25, USDEF, &to USNAV)
    COMBO(usnavretrn, 24 25, USNAV, &to USDEF)
    COMBO(usnumlayer, 34 35, USDEF, &to USNUM)
    COMBO(usnumretrn, 34 35, USNUM, &to USDEF)
    COMBO(csnavlayer, 24 25, CSDEF, &to CSNAV)
    COMBO(csnavretrn, 24 25, CSNAV, &to CSDEF)
    COMBO(csnumlayer, 34 35, CSDEF, &to CSNUM)
    COMBO(csnumretrn, 34 35, CSNUM, &to CSDEF)
    COMBO(copy, 3 4, USDEF CSDEF, &kp K_COPY)
    COMBO(paste, 15 16, USDEF CSDEF, &kp K_PASTE)
    COMBO(tab, 14 15, USDEF CSDEF, &kp TAB)
    COMBO(enter, 20 21, USDEF CSDEF, &kp ENTER)

  // ------------------------------------------------------------------------------------------------------------
  // | TIL   |  RG |  LA |  LC  |  LS  |  COL |          x         |  DQ  |  LS   |  LC   |  LA  |  RG   |  11   |
  // | DE  L |  UI |  LT |  TRL |  HFT |   ON |          x         |   T  |  HFT  |  TRL  |  LT  |  UI   |   G   |
  // |     T |   7 |   5 |   3  |   1  |   8  |          x         |   9  |   0   |   2   |   4  |   6   |   T   |
  //                            |  36  |  37  |  38    | x |  39   |  40  |  41   |
  //
    COMBO(crshft, 7 19, USDEF USNUM USNAV CSDEF CSNUM CSNAV, &kpsk RSHFT RSHFT)
    COMBO(clshft, 4 16, USDEF USNUM USNAV CSDEF CSNUM CSNAV, &kpsk LSHFT LSHFT)
    COMBO(crctrl, 8 20, USDEF USNUM USNAV CSDEF CSNUM CSNAV, &kpsk RCTRL RCTRL)
    COMBO(clctrl, 3 15, USDEF  USNUM USNAV CSDEF CSNUM CSNAV, &kpsk LCTRL LCTRL)
    COMBO(cllalt, 9 21, USDEF USNUM USNAV CSDEF CSNUM CSNAV, &kpsk LALT LALT)
    COMBO(crlalt, 2 14, USDEF USNUM USNAV CSDEF CSNUM CSNAV, &kpsk LALT LALT)
    COMBO(clgui, 10 22, USDEF USNUM USNAV CSDEF CSNUM CSNAV, &kpsk LGUI LGUI)
    COMBO(crgui, 1 13, USDEF USNUM USNAV CSDEF CSNUM CSNAV, &kpsk LGUI LGUI)
    COMBO(cclgui, 12 13, USDEF USNUM USNAV CSDEF CSNUM CSNAV, &kp LGUI)
    COMBO(ccrgui, 22 23, USDEF USNUM USNAV CSDEF CSNUM CSNAV, &kp RGUI)
    COMBO(usstar, 8 9, USDEF, &kp STAR)
    COMBO(csstar, 8 9, CSDEF, &kp CS_STAR)
    COMBO(usfslh, 32 33, USDEF, &kp FSLH)
    COMBO(csfslh, 32 33, CSDEF, &kp CS_FSLH)
    COMBO(usplus, 2 3, USDEF, &kp PLUS)
    COMBO(csplus, 2 3, CSDEF, &kp CS_PLUS)
    COMBO(usminus, 26 27, USDEF, &kp MINUS)
    COMBO(csminus, 26 27, CSDEF, &kp CS_MINUS)
    COMBO(uscaret, 18 19, USDEF, &kp CARET)
    COMBO(cscaret, 18 19, CSDEF, &kp CS_CARET)
    COMBO(usunder, 16 17, USDEF, &kp UNDER)
    COMBO(csunder, 16 17, CSDEF, &kp CS_UNDER)
    COMBO(usdollr, 13 14, USDEF, &kp DOLLAR)
    COMBO(csdollr, 13 14, CSDEF, &kp CS_DOLLAR)
    COMBO(usamps, 27 28, USDEF, &kp AMPS)
    COMBO(csamps, 27 28, CSDEF, &kp CS_AMPS)
    COMBO(usat, 28 29, USDEF, &kp AT)
    COMBO(csat, 28 29, CSDEF, &kp CS_AT)
    COMBO(usprcnt, 25 26, USDEF, &kp PERCENT)
    COMBO(csprcnt, 25 26, CSDEF, &kp CS_PERCENT)
    COMBO(ushash, 30 31, USDEF, &kp HASH)
    COMBO(cshash, 30 31, CSDEF, &kp CS_HASH)
    COMBO(uslpar, 19 20, USDEF, &kp LPAR)
    COMBO(cslpar, 19 20, CSDEF, &kp CS_LPAR)
    COMBO(usrpar, 21 22, USDEF, &kp RPAR)
    COMBO(csrpar, 21 22, CSDEF, &kp CS_RPAR)
    COMBO(uslbkt, 7 8, USDEF, &kp LBKT)
    COMBO(cslbkt, 7 8, CSDEF, &kp CS_LBKT)
    COMBO(usrbkt, 9 10 , USDEF, &kp RBKT)
    COMBO(csrbkt, 9 10 , CSDEF, &kp CS_RBKT)
    COMBO(uslbrc, 31 32, USDEF, &kp LBRC)
    COMBO(cslbrc, 31 32, CSDEF, &kp CS_LBRC)
    COMBO(usrbrc, 33 34, USDEF, &kp RBRC)
    COMBO(csrbrc, 33 34, CSDEF, &kp CS_RBRC)
    COMBO(usexcl, 4 5, USDEF, &kp EXCL)
    COMBO(csexcl, 4 5, CSDEF, &kp CS_EXCL)
    COMBO(usqmark, 6 7, USDEF, &kp QMARK)
    COMBO(csqmark, 6 7, CSDEF, &kp CS_QMARK)
    COMBO(ustilde, 0 12, USDEF, &kp TILDE)
    COMBO(cstilde, 0 12, CSDEF, &kp CS_TILDE)
    COMBO(uslt, 12 24, USDEF, &kp LT)
    COMBO(cslt, 12 24, CSDEF, &kp CS_LT)
    COMBO(usgt, 23 35, USDEF, &kp GT)
    COMBO(csgt, 23 35, CSDEF, &kp CS_GT)
    COMBO(uscolon, 5 17, USDEF, &kp COLON)
    COMBO(cscolon, 5 17, CSDEF, &kp CS_COLON)
    COMBO(usdqt, 6 18, USDEF, &kp DQT)
    COMBO(csdqt, 6 18, CSDEF, &kp CS_DQT)
    COMBO(uszero, 19 31, USDEF, &kp N0)
    COMBO(cszero, 19 31, CSDEF, &kp CS_N0)
    COMBO(ustwo, 20 32, USDEF, &kp N2)
    COMBO(cstwo, 20 32, CSDEF, &kp CS_N2)
    COMBO(usfour, 21 33, USDEF, &kp N4)
    COMBO(csfour, 21 33, CSDEF, &kp CS_N4)
    COMBO(ussix, 22 34, USDEF, &kp N6)
    COMBO(cssix, 22 34, CSDEF, &kp CS_N6)
    COMBO(useight, 17 29, USDEF, &kp N8)
    COMBO(cseight, 17 29, CSDEF, &kp CS_N8)
    COMBO(usone, 16 28, USDEF, &kp N1)
    COMBO(csone, 16 28, CSDEF, &kp CS_N1)
    COMBO(usthree, 15 27, USDEF, &kp N3)
    COMBO(csthree, 15 27, CSDEF, &kp CS_N3)
    COMBO(usfive, 14 26, USDEF, &kp N5)
    COMBO(csfive, 14 26, CSDEF, &kp CS_N5)
    COMBO(usseven, 13 25, USDEF, &kp N7)
    COMBO(csseven, 13 25, CSDEF, &kp CS_N7)
    COMBO(usnine, 18 30, USDEF, &kp N9)
    COMBO(csnine, 18 30, CSDEF, &kp CS_N9)    
  };

  // ------------------------------------------------------------------------------------------------------------
  // |  0    |  1  |  2  |  3   |  4   |  5   |          x         |  6   |  7    |  8    |  9   |  10   |  11   |
  // |  12   |  13 |  14 |  15  |  16  |  17  |          x         |  18  |  19   |  20   |  21  |  22   |  23   |
  // |  24   |  25 |  26 |  27  |  28  |  29  |          x         |  30  |  31   |  32   |  33  |  34   |  35   |
  //                            |  36  |  37  |  38    | x |  39   |  40  |  41   |
  //
  keymap {
    compatible = "zmk,keymap";
    // Layer list
    // 0. default_layer
    // 1. us_num_layer
    // 2. us_nav_layer
    // 3. us_adjust_layer
    // 4. cs_base_layer
    // 5. cs_dia_layer
    // 6. cs_dii_layer
    // 7. cs_num_layer
    // 8. cs_nav_layer
    // 9. cs_adjust_layer

    default_layer {
      // ------------------------------------------------------------------------------------------------------------
      // |  DEL  | `↑~ |  Y  |  O   |  L   |  Q   |                   |  F   |  B   |  D    |  P   |  =↑+  | BKSPC |
      // |  ESC  |  U  |  I  |  A   |  R   |  J   |                   |  M   |  H   |  T    |  N   |   S   |  ;↑:  |
      // |  \↑|  |  W  |  X  | ,↑<  | .↑>  | '↑"  |                   |  K   |  V   |  G    |  Z   |   C   |  /↑?  |
      //                            |NUMTAB|NUM * |NAV E  |  |NUMSPACE|NAV * |NAVESC|
      bindings = <
        &kp DEL  &kp GRAVE &kp Y &kp O     &kp L   &kp Q               &kp F     &kp B &kp D  &kp P &kp EQUAL &kp BSPC
        &kp ESC  &kp U     &kp I &kp A     &kp R   &kp J               &kp M     &kp H &kp T  &kp N &kp S     &kp SEMI
        &kp BSLH &kp W     &kp X &kp COMMA &kp DOT &kp SQT             &kp K     &kp V &kp G  &kp Z &kp C     &kp FSLH
        &lt USNUM ENTER &lt USNUM TAB &lt USNAV E  &lt USNUM SPACE  &lt USNAV ESC &lt USNAV LGUI
        >;
    };
    us_num_layer {
      // ------------------------------------------------------------------------------------------------------------
      // |   $   |  7  |  6  |  5   |  4   |  8   |                   |  ~   |  ^    |  _    |  #   |   |   |  `    |
      // |   .   |  3  |  2  |  1   |  0   |  9   |                   |  %   |  (    |  [    |  {   |   \   |  $    |
      // |   ,   |  -  |  /  |  +   |  *   |  =   |                   |  @   |  )    |  ]    |  }   |   !   |  &    |
      //                            |      |      |        |  |       |      |       |
      bindings = <
        &kp DOLLAR &kp N7    &kp N6   &kp N5   &kp N4   &kp N8                  &kp TILDE   &kp CARET &kp UNDER &kp HASH &kp PIPE &kp GRAVE
        &kp DOT    &kp N3    &kp N2   &kp N1   &kp N0   &kp N9                  &kp AT      &kp LPAR  &kp LBKT  &kp LBRC &kp BSLH &kp DOLLAR
        &kp COMMA  &kp MINUS &kp FSLH &kp PLUS &kp STAR &kp EQUAL               &kp PERCENT &kp RPAR  &kp RBKT  &kp RBRC &kp EXCL &kp AMPS
        &to USDEF   &kp TAB &kp ENTER  &kp SPACE &kp ESC   &to USDEF
        >;
    };

    us_nav_layer {
      bindings = <
        &bt BT_SEL 0 &kp F9 &kp F10 &kp F11 &kp F12   &tog USADJ                  &kp INS   &kp HOME  &kp UP   &kp END   &kp PG_UP &kp C_VOL_UP
        &bt BT_SEL 1 &kp F5 &kp F6  &kp F7  &kp F8    &kp K_PLAY_PAUSE            &kp CAPS  &kp LEFT  &kp DOWN &kp RIGHT &kp PG_DN &kp C_MUTE
        &bt BT_SEL 2 &kp F1 &kp F2  &kp F3  &kp F4    &kp K_MENU                  &kp PSCRN &kp H     &kp J    &kp K     &kp L     &kp C_VOL_DN
        &to USDEF  &kp TAB   &kp ENTER  &kp SPACE &kp ESC   &to USDEF
        >;
    };

    us_adjust_layer {
      bindings = <
        &bootloader &none        &none        &none        &none        &tog USADJ                  &kp PAUSE_BREAK &kp C_BRI_UP &kp C_BRI_DN &none       &none  &none
        &bt BT_CLR  &bt BT_SEL 0 &bt BT_SEL 1 &bt BT_SEL 2 &bt BT_SEL 3 &bt BT_SEL 4                &kp SYSREQ      &kp K_POWER  &kp K_SLEEP  &kp K_LOCK  &none  &none
        &sys_reset  &none        &none        &none        &none        &none                       &kp K_CANCEL    &none        &none        &none       &none  &none
        &to USDEF    &to USDEF &to USDEF &to USDEF &to USDEF &to USDEF
        >;
    };

    cs_def_layer {
        bindings = <
        &kp DEL   &csgrave &kp CS_Y &kp CS_O &kp CS_L &kp CS_Q                &kp CS_F     &kp CS_B &kp CS_D &kp CS_P &csequal &kp BSPC
        &kp ESC   &kp CS_U &kp CS_I &kp CS_A &kp CS_R &kp CS_J                &kp CS_M     &kp CS_H &kp CS_T &kp CS_N &kp CS_S &cssemi
        &csbslh   &kp CS_W &kp CS_X &cscomma &csdot   &csquote                &kp CS_K     &kp CS_V &kp CS_G &kp CS_Z &kp CS_C &csfslh
        &lt CSNUM ENTER &ldia_mosl CSNUM CSDIA  &lt CSNAV CS_E  &lt CSNUM SPACE  &rdia_mosl CSNAV CSDIA  &lt CSNAV LGUI
        >;
    };

    cs_dia_layer {
      // ------------------------------------------------------------------------------------------------------------
      // |  DEL  |  ß  |  ý  |  ó   |  ?   |  ÷   |                   |  ň   |  !   |  ž    |  ú   |   °   | BKSPC |
      // |   §   |  ů  |  í  |  á   |  ř   |  ˇ   |                   |  ´   |  ě   |  č    |  é   |   š   |   º   |
      // |   Ω   |  ẞ  |  ¨  |  ť   |  ď   |  ×   |                   |  ı   |  ←   |  ↓    |  ↑   |   →   |   ¦   |
      //                            |  DII |      |  SPACE |  | ENTER |      |      |
      bindings = <
        &kp DEL      &kp CS_SZ       &kp CS_Y_ACUTE &cs_o_acute    &kp CS_QMARK   &kp CS_DIV               &cs_n_caron     &kp CS_EXCL      &kp CS_Z_CARON &kp CS_U_ACUTE  &kp CS_DEAD_RING &kp BSPC
        &kp CS_DEG   &kp CS_U_RING   &kp CS_I_ACUTE &kp CS_A_ACUTE &kp CS_R_CARON &kp CS_CARON             &kp CS_ACUTE    &kp CS_E_CARON   &kp CS_C_CARON &kp CS_E_ACUTE  &kp CS_S_CARON   &kp CS_SECT
        &kp CS_OMEGA &kp CS_SZ_SMALL &kp CS_UMLAUT  &cs_t_caron    &cs_d_caron    &kp CS_MULT              &kp CS_NEGATE   &kp CS_LARROW    &kp CS_DARROW  &kp CS_UARROW   &kp CS_RARROW    &kp CS_PSEUDOPIPE
        &sl CSDII        &to CSDEF      &to CSDEF   &to CSDEF &to CSDEF       &sl CSDII
        >;
    };

    cs_dii_layer {
      // ------------------------------------------------------------------------------------------------------------
      // |  DEL  |  °  |  ¥  |  ø   |  Ø   |      |                   |  đ   |  Ð   |  ¯    |  ł   |   Ł   | BKSPC |
      // |   ˝   |  Ħ  |  ˛  |  €   |  Æ   |  ¶   |                   |  ®   |  ‚   |  ‘    |  ’   |   þ   |   Þ   |
      // |   `   |  ^  |  ˘  |  ¸   |  ©   |  ˙   |                   |  ŧ   |  Ŧ   |  Ŋ    |  Ω   |   ª   |   ´   |
      //                            |      |      |  SPACE |  | ENTER |      |      |
      bindings = <
        &kp DEL             &kp CS_RING     &kp CS_YEN    &kp CS_OCROSS  &kp CS_OCROSS_CAP &none                           &kp CS_D_STROKE  &kp CS_D_STROKE_CAP  &kp CS_BAR_ABOVE   &kp CS_L_STROKE    &kp CS_L_STROKE_CAP &kp BSPC
        &kp CS_DOUBLE_ACUTE &kp CS_H_STROKE &kp CS_OGONEK &kp CS_EURO    &kp CS_AE         &kp CS_PARAG                    &kp CS_RMARK     &kp CS_BOTTOM_SQT    &kp CS_UPPER_SQT_L &kp CS_UPPER_SQT_R &kp CS_PLINE        &kp CS_PLINE_CAP
        &kp CS_DEAD_GRAVE_L &kp CS_HAT      &kp CS_BREVE  &kp CS_CEDILLA &kp CS_CMARK      &kp CS_DOT_ABOVE                &kp CS_T_STROKE  &kp CS_T_STROKE_CAP  &kp CS_ETA         &kp CS_OMEGA       &kp CS_A_INDEX      &kp CS_DEAD_GRAVE_R
        &to CSDEF         &to CSDEF        &to CSDEF  &to CSDEF &to CSDEF &to CSDEF
        >;
    };

    cs_num_layer {
      // ------------------------------------------------------------------------------------------------------------
      // |   $   |  7  |  6  |  5   |  4   |  8   |                   |  ~   |  ^    |  _    |  #   |   |   |  `    |
      // |   .   |  3  |  2  |  1   |  0   |  9   |                   |  %   |  (    |  [    |  {   |   \   |  $    |
      // |   ,   |  -  |  /  |  +   |  *   |  =   |                   |  @   |  )    |  ]    |  }   |   !   |  &    |
      //                            |      |      |        |  |       |      |       |
      bindings = <
        &kp CS_DOLLAR &kp CS_N7        &kp CS_N6   &kp CS_N5   &kp CS_N4   &kp CS_N8                         &kp CS_TILDE   &kp CS_CARET &kp CS_UNDER &kp CS_HASH &kp CS_PIPE &kp CS_GRAVE
        &kp CS_DOT    &kp CS_N3        &kp CS_N2   &kp CS_N1   &kp CS_N0   &kp CS_N9                         &kp CS_AT      &kp CS_LPAR  &kp CS_LBKT  &kp CS_LBRC &kp CS_BSLH &kp CS_DOLLAR
        &kp CS_COMMA  &kp CS_MINUS     &kp CS_FSLH &kp CS_PLUS &kp CS_STAR &kp CS_EQUAL                      &kp CS_PERCENT &kp CS_RPAR  &kp CS_RBKT  &kp CS_RBRC &kp CS_EXCL &kp CS_AMPS
        &to CSDEF   &kp TAB      &kp ENTER  &kp SPACE &kp ESC        &to CSDEF
        >;
    };

    cs_nav_layer {
      bindings = <
        &bt BT_SEL 0 &kp F9 &kp F10 &kp F11 &kp F12   &tog USADJ                  &kp INS   &kp HOME  &kp UP   &kp END   &kp PG_UP &kp C_VOL_UP
        &bt BT_SEL 1 &kp F5 &kp F6  &kp F7  &kp F8    &kp K_PLAY_PAUSE            &kp CAPS  &kp LEFT  &kp DOWN &kp RIGHT &kp PG_DN &kp C_MUTE
        &bt BT_SEL 2 &kp F1 &kp F2  &kp F3  &kp F4    &kp K_MENU                  &kp PSCRN &kp H     &kp J    &kp K     &kp L     &kp C_VOL_DN
        &to CSDEF  &kp TAB   &kp ENTER  &kp SPACE &kp ESC   &to CSDEF
        >;
    };

    cs_adjust_layer {
      bindings = <
        &bootloader &none        &none        &none        &none        &tog USADJ                  &kp PAUSE_BREAK &kp C_BRI_UP &kp C_BRI_DN &none       &none  &none
        &bt BT_CLR  &bt BT_SEL 0 &bt BT_SEL 1 &bt BT_SEL 2 &bt BT_SEL 3 &bt BT_SEL 4                &kp SYSREQ      &kp K_POWER  &kp K_SLEEP  &kp K_LOCK  &none  &none
        &sys_reset  &none        &none        &none        &none        &none                       &kp K_CANCEL    &none        &none        &none       &none  &none
        &to USDEF    &to USDEF &to USDEF &to USDEF &to USDEF &to USDEF
        >;
    };
  };
  };
